## CMakeLists.txt
```
# SPDX-License-Identifier: Apache-2.0

cmake_minimum_required(VERSION 3.20.0)

find_package(Zephyr REQUIRED HINTS $ENV{ZEPHYR_BASE})
project(riscv64app)

set(DRIVERS_SRC
    drivers/src/gpio.c
    drivers/src/mmio.c
    drivers/src/timer.c
    drivers/src/uart.c
)

set(DRIVERS_INC
    drivers/inc/gpio.h
    drivers/inc/mmio.h
    drivers/inc/timer.h
    drivers/inc/uart.h
)

set(HAL_SRC
    hal/src/hal_gpio.c
    hal/src/hal_timer.c
    hal/src/hal_uart.c
)

set(HAL_INC
    hal/inc/hal_gpio.h
    hal/inc/hal_timer.h
    hal/inc/hal_uart.h
)

# Include directories
include_directories(${CMAKE_SOURCE_DIR}/drivers/inc)
include_directories(${CMAKE_SOURCE_DIR}/hal/inc)

target_sources(app PRIVATE src/main.c ${DRIVERS_SRC} ${DRIVERS_INC} ${HAL_SRC} ${HAL_INC})
```

## prj.conf
```kconfig
# nothing here
# Define flash memory base and size
# CONFIG_FLASH_BASE_ADDRESS=0x00001000
# CONFIG_FLASH_SIZE=0x00010000

# Define RAM memory base and size
CONFIG_SRAM_BASE_ADDRESS=0x80100000
# CONFIG_SRAM_SIZE=0x07000000
```

## src/main.c
```c
/*
 * Copyright (c) 2012-2014 Wind River Systems, Inc.
 *
 * SPDX-License-Identifier: Apache-2.0
 */

#include <stdio.h>
#include "gpio.h"
#include "uart.h"
#include "timer.h"
#include "mmio.h"

int main(void)
{
	printf("Hello World! %s\n", CONFIG_BOARD_TARGET);

	return 0;
}
```
